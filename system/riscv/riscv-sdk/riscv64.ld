ENTRY(_start)

MEMORY
{
/*  BOOT (rx) : ORIGIN = 0x30000000,LENGTH = 16k   */
    RAM  (xrw): ORIGIN = 0x80000000,LENGTH = 128m
/*  DDR  (xrw): ORIGIN = 0x90000000,LENGTH = 1024m  */
}

SECTIONS {
  /* _pmem_start and _entry_offset are defined in LDFLAGS */
  . = _pmem_start + _entry_offset;
  .text : {
    *(entry)
    *(.text*)
  }
  etext = .;
  _etext = .;
  .rodata : {
    *(.rodata*)
  }
  .data : {
    *(.data)
  }
  edata = .;
  _data = .;
  .bss : {
	_bss_start = .;
    *(.bss*)
    *(.sbss*)
    *(.scommon)
  }
  _stack_top = 0x80001000;
  . = _stack_top + 0x8000;
  _stack_pointer = .;
  end = .;
  _end = .;
  _heap_start = ALIGN(0x1000);
}
